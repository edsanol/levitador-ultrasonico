#include <avr/sleep.h>
#include <avr/power.h>

#define N_PORTS 1 // Numero de puertos con los que se trabajara en la función macro
#define N_DIVS 40 // Numero de filas dentro de la matriz de animación
#define N_BUTTONS 6 // Numero de botones que pueden usarsen
#define STEP_SIZE 1 // Tamaño de cada paso
#define BUTTON_SENS 4000 // Sensibilidad del boton
#define N_FRAMES 40 // Numero de columnas de la matriz animación

#define WAIT_LOT(a) __asm__ __volatile__ ("nop"); __asm__ __volatile__ ("nop");  __asm__ __volatile__ ("nop");  __asm__ __volatile__ ("nop");  __asm__ __volatile__ ("nop");__asm__ __volatile__ ("nop");__asm__ __volatile__ ("nop")
#define WAIT_MID(a) __asm__ __volatile__ ("nop"); __asm__ __volatile__ ("nop");  __asm__ __volatile__ ("nop"); __asm__ __volatile__ ("nop"); __asm__ __volatile__ ("nop");__asm__ __volatile__ ("nop")
#define WAIT_LIT(a) __asm__ __volatile__ ("nop");  __asm__ __volatile__ ("nop");  __asm__ __volatile__ ("nop"); __asm__ __volatile__ ("nop")


#define OUTPUT_WAVE(pointer, d)  PORTC = pointer[d*N_PORTS + 0]



static byte frame = 0;
static byte animation[N_FRAMES][N_DIVS] = 
{{0x5,0x5,0x5,0x5,0x5,0x5,0x5,0x5,0x5,0x5,0x5,0x5,0x5,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0xa,0xa},
{0x9,0x5,0x5,0x5,0x5,0x5,0x5,0x5,0x5,0x5,0x5,0x5,0x5,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0xa,0xa},
{0x9,0x9,0x5,0x5,0x5,0x5,0x5,0x5,0x5,0x5,0x5,0x5,0x5,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0xa,0xa},
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{0x5,0x5,0x5,0x5,0x5,0x5,0x5,0x5,0x5,0x5,0x5,0x5,0x5,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0xa,0x6}};

void setup()
{
   DDRC = 0b00001111;     //A0 a A3 son señales de salida
   PORTC = 0b00000000;    //Pines a nivel bajo
   
   pinMode(10, OUTPUT);       //pin 10 (B2) generará una señal 40KHz a sincronismo    
   pinMode(11, INPUT_PULLUP); //pin 11 (B3) es el sincronismo de entrada                  
   //IMPORTANTE tener conectado el pin 10 con el 11

   for (int i = 2; i < 8; ++i){   //pin 2 a 7 (D2 a D7) son entradas para los botones
    pinMode(i, INPUT_PULLUP); 
   }

  // Genera una señal de sincronismo de 40 KHz en el pin 10
  noInterrupts();           // dehabilita todas las interrupciones
  TCCR1A = bit (WGM10) | bit (WGM11) | bit (COM1B1); // fast PWM, reinicia OC1B comparación
  TCCR1B = bit (WGM12) | bit (WGM13) | bit (CS10);   // fast PWM, no prescaler
  OCR1A =  (F_CPU / 40000L) - 1;
  OCR1B = (F_CPU / 40000L) / 2;
  interrupts();             // habilita todas las interrupciones

  // deshabilitamos todo lo que no necesitamos
  ADCSRA = 0;  // ADC
  power_adc_disable ();
  power_spi_disable();
  power_twi_disable();
  power_timer0_disable();
  //power_usart0_disable();
  Serial.begin(115200);

 byte* emittingPointer = &animation[frame][0];
 byte buttonsPort = 0;

 bool anyButtonPressed;
 bool buttonPressed[N_BUTTONS];
 short buttonCounter = 0;

  LOOP:
    while(PINB & 0b00001000); //esperamos a que el pin 11 (B3) se encuentre en nivel bajo                         
    
    OUTPUT_WAVE(emittingPointer, 0); buttonsPort = PIND; WAIT_LIT();
    OUTPUT_WAVE(emittingPointer, 1); anyButtonPressed = (buttonsPort & 0b11111100) != 0b11111100; WAIT_LOT();
    OUTPUT_WAVE(emittingPointer, 2); buttonPressed[0] = buttonsPort & 0b00000100; WAIT_LOT();
    OUTPUT_WAVE(emittingPointer, 3); buttonPressed[1] = buttonsPort & 0b00001000; WAIT_LOT();
    OUTPUT_WAVE(emittingPointer, 4); buttonPressed[2] = buttonsPort & 0b00010000; WAIT_LOT();
    OUTPUT_WAVE(emittingPointer, 5); buttonPressed[3] = buttonsPort & 0b00100000; WAIT_LOT();
    OUTPUT_WAVE(emittingPointer, 6); buttonPressed[4] = buttonsPort & 0b01000000; WAIT_LOT();
    OUTPUT_WAVE(emittingPointer, 7); buttonPressed[5] = buttonsPort & 0b10000000; WAIT_LOT();
    OUTPUT_WAVE(emittingPointer, 8); WAIT_LOT();
    OUTPUT_WAVE(emittingPointer, 9); WAIT_LOT();
    OUTPUT_WAVE(emittingPointer, 10); WAIT_LOT();
    OUTPUT_WAVE(emittingPointer, 11); WAIT_LOT();
    OUTPUT_WAVE(emittingPointer, 12); WAIT_LOT();
    OUTPUT_WAVE(emittingPointer, 13); WAIT_LOT();
    OUTPUT_WAVE(emittingPointer, 14); WAIT_LOT();
    OUTPUT_WAVE(emittingPointer, 15); WAIT_LOT();
    OUTPUT_WAVE(emittingPointer, 16); WAIT_LOT();
    OUTPUT_WAVE(emittingPointer, 17); WAIT_LOT();
    OUTPUT_WAVE(emittingPointer, 18); WAIT_LOT();
    OUTPUT_WAVE(emittingPointer, 19); WAIT_LOT();
    OUTPUT_WAVE(emittingPointer, 20); WAIT_MID();
    OUTPUT_WAVE(emittingPointer, 21); WAIT_MID();
    OUTPUT_WAVE(emittingPointer, 22); WAIT_MID();
    OUTPUT_WAVE(emittingPointer, 23); WAIT_MID();
    OUTPUT_WAVE(emittingPointer, 24); WAIT_MID();
    OUTPUT_WAVE(emittingPointer, 25); WAIT_MID();
    OUTPUT_WAVE(emittingPointer, 26); WAIT_MID();
    OUTPUT_WAVE(emittingPointer, 27); WAIT_MID();
    OUTPUT_WAVE(emittingPointer, 28); WAIT_MID();
    OUTPUT_WAVE(emittingPointer, 29); WAIT_MID();
    OUTPUT_WAVE(emittingPointer, 30); WAIT_MID();
    OUTPUT_WAVE(emittingPointer, 31); WAIT_MID();
    OUTPUT_WAVE(emittingPointer, 32); WAIT_MID();
    OUTPUT_WAVE(emittingPointer, 33); WAIT_MID();
    OUTPUT_WAVE(emittingPointer, 34); WAIT_MID();
    OUTPUT_WAVE(emittingPointer, 35); WAIT_MID();
    OUTPUT_WAVE(emittingPointer, 36); WAIT_MID();
    OUTPUT_WAVE(emittingPointer, 37); WAIT_MID();
    OUTPUT_WAVE(emittingPointer, 38); WAIT_MID();
    OUTPUT_WAVE(emittingPointer, 39); 

    if( anyButtonPressed )  //Si algún botón pulsado
    {     
       ++buttonCounter;         //Contador ++
       
       if (buttonCounter > BUTTON_SENS)   //Si contador es mayor a BUTTON_SENS (2500)
       {    
          buttonCounter = 0;                  //Contador a 0
        
          if (! buttonPressed[0] )   //Si buttonPressed[0] no es True
          {         
            if( frame < STEP_SIZE )   //Si frame es menor a STEP_SIZE (1)
            {   
              frame = N_FRAMES-1;       //frame será igual a N_FRAMES (24) - 1
            }
            else
            {
              frame-=STEP_SIZE; 
            }
          }        
          else if (! buttonPressed[1] )   //Si buttonPressed[1] no es True 
          {          
            if ( frame >= N_FRAMES-STEP_SIZE )   //Si frame es mayor o igual que N_FRAMES-STEP_SIZE (24 - 1) 
            {   
              frame = 0;                           //Ponemos frame a 0
            }
            else   //Si no
            {                                
              frame+=STEP_SIZE;                    //frame será frame + STEP_SIZE (1)
            }  
          }          
          else if (! buttonPressed[2] )     //Si buttonPressed[2] no es True 
          {          
            frame = 0;                              //Ponemos frame a 0
          }
       
         emittingPointer = & animation[frame][0];  //Selecciona la posición de la matriz porque hemos dicho el valor de frame
       }
    }
    
    else     //Si no
    {                
      buttonCounter = 0;    //Contador a 0
    }

    //Serial.println(animation[frame][0]);
    
  goto LOOP;
  
}

void loop(){}
